## components/bsp/Kconfig
```kconfig
menu "InkFlash board"

    choice INK_BOARD
        prompt "Board"
        default INK_BOARD_BREADBOARD_GD0
        help
            Chọn bảng chân. Nguồn sự thật: docs/hardware/pinmap.md.

        config INK_BOARD_BREADBOARD_GD0
            bool "GĐ0: DevKitC-1 N16R8 trên breadboard"
        config INK_BOARD_PCB_V1
            bool "PCB InkFlash v1"
    endchoice

endmenu
```

## components/drivers/drv_audio/Kconfig
```kconfig
menu "InkFlash audio drivers"

    choice INK_MIC_DRIVER
        prompt "Mic driver"
        default INK_MIC_FAKE
        config INK_MIC_NONE
            bool "Không có mic"
        config INK_MIC_FAKE
            bool "Giả lập (im lặng)"
        config INK_MIC_INMP441
            bool "INMP441 (I2S)"
    endchoice

    choice INK_SPEAKER_DRIVER
        prompt "Speaker driver"
        default INK_SPEAKER_FAKE
        config INK_SPEAKER_NONE
            bool "Không có loa"
        config INK_SPEAKER_FAKE
            bool "Giả lập (bỏ dữ liệu)"
        config INK_SPEAKER_MAX98357A
            bool "MAX98357A (amp I2S)"
    endchoice

endmenu
```

## components/drivers/drv_display/Kconfig
```kconfig
menu "InkFlash display driver"

    choice INK_DISPLAY_DRIVER
        prompt "Display driver"
        default INK_DISPLAY_FAKE
        help
            Chọn driver màn hình. Thêm chip mới: thêm display_<chip>.c xuất drv_display_chip_t.

        config INK_DISPLAY_NONE
            bool "Không có màn"
        config INK_DISPLAY_FAKE
            bool "Giả lập (chưa có linh kiện)"
        config INK_DISPLAY_UC8253
            bool "UC8253: Good Display GDEY037T03 (WeAct 3.7\", 240x416)"
    endchoice

    config INK_DISPLAY_UC8253_FAST_FULL
        bool "Làm mới toàn phần nhanh (~1 s, dễ để lại bóng mờ)"
        depends on INK_DISPLAY_UC8253
        default n
        help
            Bật: ép nhiệt độ để làm mới toàn phần chỉ khoảng 1 giây nhưng ảnh hơi xám, dễ còn bóng.
            Tắt (mặc định): sóng chuẩn, khoảng 3 giây, sạch hơn.

    config INK_DISPLAY_UC8253_CLEAN_CYCLES
        int "Số vòng đen→trắng khi xoá sạch màn"
        depends on INK_DISPLAY_UC8253
        range 0 3
        default 1
        help
            Dùng cho chế độ CLEAN và cho lần xoá lúc khởi động. Mỗi vòng gồm hai lần làm mới toàn phần
            (cả màn đen rồi cả màn trắng), khoảng 6 giây với sóng chuẩn. 0 = chỉ xoá trắng một lần.

endmenu
```

## components/drivers/drv_power/Kconfig
```kconfig
menu "InkFlash power driver"

    choice INK_POWER_DRIVER
        prompt "Power driver"
        default INK_POWER_ESP32
        help
            Chọn driver nguồn và quản lý deep sleep.

        config INK_POWER_NONE
            bool "Không có (không đo pin, không ngủ sâu)"
        config INK_POWER_FAKE
            bool "Giả lập (pin 3900 mV, ngủ sâu chỉ ghi log)"
        config INK_POWER_ESP32
            bool "ESP32-S3 sleep (ngủ sâu thật bằng RTC GPIO, tắt rail phụ)"
    endchoice

endmenu
```

## components/drv_imu/Kconfig
```kconfig
menu "InkFlash IMU driver"

    choice INK_IMU_DRIVER
        prompt "IMU driver"
        default INK_IMU_FAKE
        help
            Chọn driver cho cảm biến gia tốc. Thêm chip mới: xem components/drv_imu/README.md.

        config INK_IMU_NONE
            bool "Không có IMU"
        config INK_IMU_FAKE
            bool "Giả lập (chưa có linh kiện)"
        config INK_IMU_BNO055
            bool "BNO055 (I2C, có fusion)"
    endchoice

endmenu
```

## components/drv_power/Kconfig
```kconfig
menu "InkFlash power driver"

    choice INK_POWER_DRIVER
        prompt "Power driver"
        default INK_POWER_FAKE
        help
            Driver BQ25180 + TPS22916 sẽ thêm sau khi docs/hardware/power.md đã xác nhận.

        config INK_POWER_NONE
            bool "Không có (không đo pin, không ngủ sâu)"
        config INK_POWER_FAKE
            bool "Giả lập (pin 3900 mV, ngủ sâu chỉ ghi log)"
    endchoice

endmenu
```

## components/services/Kconfig
```kconfig
menu "InkFlash services"

    config INK_INPUT_LONG_PRESS_MS
        int "Ngưỡng nhấn giữ (ms)"
        default 600

    config INK_POWER_IDLE_SLEEP_S
        int "Không thao tác bao lâu thì ngủ sâu (giây)"
        default 120

endmenu
```

## docs/demo-v0/components/bsp/Kconfig
```kconfig
menu "InkFlash BSP"

    choice INK_BOARD
        prompt "Board"
        default INK_BOARD_BREADBOARD_GD0
        help
            Chọn bộ chân nối. Bảng chân nằm trong docs/hardware/pinmap.md.

        config INK_BOARD_BREADBOARD_GD0
            bool "GĐ0: DevKitC-1 N16R8 trên breadboard"
        config INK_BOARD_PCB
            bool "PCB InkFlash"
    endchoice

endmenu
```

## docs/demo-v0/components/drivers/drv_led/Kconfig
```kconfig
menu "InkFlash status LED driver"

    choice INK_LED_DRIVER
        prompt "LED driver"
        default INK_LED_NONE
        config INK_LED_NONE
            bool "Không có LED"
        config INK_LED_WS2812
            bool "WS2812 / NeoPixel (RMT)"
    endchoice

endmenu
```
